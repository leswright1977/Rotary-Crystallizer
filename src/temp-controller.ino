#include <OneWire.h>
#include <DallasTemperature.h>
#include <SPI.h>
#include <Wire.h>
#include <Adafruit_GFX.h>
#include <Adafruit_SSD1306.h>

//Screen setup!
#define SCREEN_WIDTH 128 // OLED display width, in pixels
#define SCREEN_HEIGHT 64 // OLED display height, in pixels
#define OLED_RESET     -1 // Reset pin # (or -1 if sharing Arduino reset pin)
#define SCREEN_ADDRESS 0x3C //
Adafruit_SSD1306 display(SCREEN_WIDTH, SCREEN_HEIGHT, &Wire, OLED_RESET);

const unsigned char splash [] PROGMEM = {
	0x00, 0x00, 0x00, 0x00, 0x00, 0x00, 0x00, 0x00, 0x00, 0x00, 0x00, 0x00, 0x00, 0x00, 0x00, 0x00, 
	0x00, 0x00, 0x00, 0x00, 0x00, 0x00, 0x00, 0x00, 0x00, 0x00, 0x00, 0x00, 0x00, 0x00, 0x00, 0x00, 
	0x00, 0x00, 0x00, 0x00, 0x00, 0x00, 0x00, 0x07, 0xe0, 0x00, 0x00, 0x00, 0x00, 0x00, 0x00, 0x00, 
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	0x00, 0x00, 0x00, 0x00, 0x00, 0x00, 0x00, 0x00, 0x00, 0x00, 0x00, 0x00, 0x00, 0x00, 0x00, 0x00
};

 
//Temperature setup
// Data wire is conntec to the Arduino digital pin 2
#define ONE_WIRE_BUS 2
// Setup a oneWire instance to communicate with any OneWire devices
OneWire oneWire(ONE_WIRE_BUS);
// Pass our oneWire reference to Dallas Temperature sensor 
DallasTemperature sensors(&oneWire);

//for target temp
unsigned long previousMillis = 0;  // will store last time target was updated
//120 minutes  = 7200000 mS //change every 2 hours or 0.75 deg/day
//90 minutes =   5400000 mS  // change every 1 hr 30 min  1 deg/day
//60 minutes   = 3600000 mS //1.5 degree per day at 0.0625
//51.4 minutes = 3085714 mS //28 changes at 0.0625 1.75 degrees per day
//45 minutes   = 2700000 mS //45 minutes at a tempchange of 0.0625 this is 2 deg per day
//36 minutes   = 2160000 mS //36 minutes 2.5 deg per day
//30 minutes   = 1800000 mS //At a change of tempChange of 0.0625 in 30 min this is 3 deg per day
//22.5 minutes = 1350000 mS //1/64th of a day 22 minutes 30 seconds. At a change of tempChange of 0.0625 this is 4 deg per day
//15 minutes   = 900000 mS // 6 degrees per day at 0.0625 degrees

long interval = 0;//the interval at which to change the temp
const double tempChange = 0.0625; //temperature change to make (and the max res of the sensor)
const int initTemp = 47; //47 degree start temp

//const long phase1 = 1800000;   //Change every 30 minutes 3 deg / day Shed tests
//const long phase1 = 2160000;   //Change every 36 minutes 2.5 deg per day //////////TEST 28
const long phase1 = 3085714;     //Change every 51.4 minutes 0.0625 1.75 degrees per day TEST 29
const long phase2 = 7200000;     //change every 2 hours or 0.75 deg/day
const long phase3 = 3600000;     //Change every 1 hours or 1.5 degree per day at 0.0625
const long phase4 = 2700000;     //Change every 45 minutes 2 deg / day //////////TEST 19
 

//configure pins
const int heater = 3;
const int sw1 = 4;
const int sw2 = 11;

float curTemp;
float startTemp;
float targetTemp;

int getStartTemp = 1; //will we query the current temp as the start temp?
int machineStatus = 0;
String statusMsg;
String spinner = "/-\\|/-\\|";
int spinnerpos = 0;
int serialMessages = 0;

void setup() 
{
  //Setuup all inputs and outputs...
  pinMode(heater, OUTPUT);
  digitalWrite(heater, LOW);
  pinMode(sw1, INPUT);
  pinMode(sw2, INPUT);

  // Start up the OLED library
  sensors.begin();
  sensors.setResolution(12);//set resolution to 1/10th degree.

  //init the display
  if(!display.begin(SSD1306_SWITCHCAPVCC, 0x3C)) { // Address 0x3D for 128x64
    //Serial.println(F("SSD1306 allocation failed"));
    for(;;);
  };
  delay(1000);
  display.clearDisplay();
  display.drawBitmap(0, 0, splash, 128, 64, WHITE);
  display.display(); 
  delay(1000);
  Serial.begin(115200);
};
 
void loop() {
  //get and print temperature
  sensors.setWaitForConversion(false);
  sensors.requestTemperatures();
  curTemp = sensors.getTempCByIndex(0); 

  //get the panel switch states!
  int panel1 = digitalRead(sw1);
  int panel2 = digitalRead(sw2);
  /////////////Might set this to the start temp 46.6 degrees///////////////////////
  if(panel1==LOW && panel2==LOW){
    machineStatus = 0;//Off!
    statusMsg = "   OFF!   ";
    getStartTemp = 1;//re-enable get start temp.
    targetTemp = 0;
  };
  if(panel1==HIGH && panel2==LOW){
    machineStatus = 1;//Running: Slow cooling
    //Go get the target temp when we flick the switch
    if (getStartTemp == 1){ //get the start temp, then disable this section...
      sensors.requestTemperatures(); 
      startTemp = sensors.getTempCByIndex(0);
      targetTemp = startTemp;
      getStartTemp = 0;
    };

    /*
    //the cooling curve (test 16)
    if(targetTemp > initTemp){
      statusMsg = "Starting";
      targetTemp = initTemp;
    }else if(targetTemp > 44.5){
      statusMsg = "Growing";
      interval = phase1;
    }else{
      statusMsg = "Slow";
      interval = phase2;    
    };
    */
    //test 17, 18, 19
    if(targetTemp >= initTemp){
      statusMsg = "Starting";
      targetTemp = initTemp;
    }else if(targetTemp > 44.5){
      statusMsg = "Phase 1";
      interval = phase1; 
    }else if(targetTemp > 43.0){
      statusMsg = "Phase 2";
      interval = phase2;   
    }else if(targetTemp > 40.0){
      statusMsg = "Phase 3";
      interval = phase3;        
    }else{
      statusMsg = "Phase 4";
      interval = phase4;      
    }
    
    
  };
  if(panel1==LOW && panel2==HIGH){
    machineStatus = 2;//Pre-Heat (55 degrees)
    statusMsg = "Pre-Heat";
    targetTemp = 54;
    getStartTemp = 1;//re-enable get start temp.
  };
  if(panel1==HIGH && panel2==HIGH){
    machineStatus = 3;//Overheating program (70 Degrees)
    statusMsg = "Over-Heat";
    targetTemp = 70;
    getStartTemp = 1;//re-enable get start temp.
  };


  
  display.clearDisplay();
  display.drawRect(0,0,128,64, SSD1306_WHITE);
  display.setTextSize(2);
  display.setTextColor(WHITE);

  display.setCursor(5, 5);
  display.print(statusMsg); 

  if(machineStatus !=0){
    display.setCursor(113, 5);
    display.print(spinner[spinnerpos]);
    spinnerpos++;
    if(spinnerpos == 7){
      spinnerpos=0;
    };
  };
  
  display.setCursor(5, 25);
  display.print("C:");
  display.print(curTemp,3);
  display.print((char)247); // degree symbol 
  display.print("C");

  display.setCursor(5,45);
  display.print("T:");
  display.print(targetTemp,3);
  display.print((char)247); // degree symbol 
  display.print("C");

  display.display(); 


  //check whether it is time to lower the target temperature?
  if (machineStatus == 1){ //only do this if we are slow cooling!!
    unsigned long currentMillis = millis();
    if (currentMillis - previousMillis >= interval) {
      // save the last time we changed
      previousMillis = currentMillis;
      targetTemp = targetTemp-tempChange;
    };
  };


  
  
  //Serial.println(interval-(currentMillis - previousMillis));
  //int countdown = (interval-(currentMillis - previousMillis))/1000;
  //Serial.println(countdown);

  //Decide what to do about the temperature.
  //Since there is only a relay to control the heater and not PWM, 
  //PID seems like overkill.
  //The original Holden Crystallizer used a Mercury Thermoregulator with an adjustable
  //setpoint and a resolution of 0.1 degree
  if(curTemp < targetTemp){
    //then heat!
    digitalWrite(heater, HIGH);
  };
    if(curTemp >= targetTemp){
    //then cool!
    digitalWrite(heater, LOW);
  };

  //send data every 30 seconds or so
  //serialMessages++;
  //if(serialMessages >=350){
  //Comment out the loop to just send data as fast as!
    Serial.print(statusMsg);
    Serial.print(","); 
    Serial.print(targetTemp,4);
    Serial.print(",");
    Serial.print(curTemp,4);
    Serial.print("\r\n");
    //serialMessages = 0;
  //};

}
